## boards/shields/xiaord_scanner/Kconfig.shield
```kconfig
config SHIELD_XIAORD_SCANNER
    def_bool $(shields_list_contains,xiaord_scanner)
```

## config/boards/shields/xiaord_scanner/Kconfig.defconfig
```kconfig
if SHIELD_XIAORD_SCANNER

config ZMK_KEYBOARD_NAME
    default "XIAO RD Scanner"

endif 
```

## config/west.yml
```yaml
manifest:
  remotes:
    - name: zmkfirmware
      url-base: https://github.com/zmkfirmware
    - name: prospector
      url-base: https://github.com/t-ogura
  projects:
    - name: zmk
      remote: zmkfirmware
      revision: main
      import: app/west.yml
    - name: prospector-zmk-module
      url: https://github.com/kix27/prospector-zmk-module-for-xiaodisplay.git
      revision: main
      path: modules/prospector-zmk-module
    - name: zmk-module-xiaord
      url: https://github.com/kix27/zmk-module-xiaord.git
      revision: main
  self:
    path: config 
```
